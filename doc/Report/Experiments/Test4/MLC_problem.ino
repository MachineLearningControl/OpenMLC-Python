// Variable Declarations

/*int sinwave[120] = {
  // Sin wave
  
    0x7ff, 0x86a, 0x8d5, 0x93f, 0x9a9, 0xa11, 0xa78, 0xadd, 0xb40, 0xba1,
    0xbff, 0xc5a, 0xcb2, 0xd08, 0xd59, 0xda7, 0xdf1, 0xe36, 0xe77, 0xeb4,
    0xeec, 0xf1f, 0xf4d, 0xf77, 0xf9a, 0xfb9, 0xfd2, 0xfe5, 0xff3, 0xffc,
    0xfff, 0xffc, 0xff3, 0xfe5, 0xfd2, 0xfb9, 0xf9a, 0xf77, 0xf4d, 0xf1f,
    0xeec, 0xeb4, 0xe77, 0xe36, 0xdf1, 0xda7, 0xd59, 0xd08, 0xcb2, 0xc5a,
    0xbff, 0xba1, 0xb40, 0xadd, 0xa78, 0xa11, 0x9a9, 0x93f, 0x8d5, 0x86a,
    0x7ff, 0x794, 0x729, 0x6bf, 0x655, 0x5ed, 0x586, 0x521, 0x4be, 0x45d,
    0x3ff, 0x3a4, 0x34c, 0x2f6, 0x2a5, 0x257, 0x20d, 0x1c8, 0x187, 0x14a,
    0x112, 0xdf, 0xb1, 0x87, 0x64, 0x45, 0x2c, 0x19, 0xb, 0x2,
    0x0, 0x2, 0xb, 0x19, 0x2c, 0x45, 0x64, 0x87, 0xb1, 0xdf,
    0x112, 0x14a, 0x187, 0x1c8, 0x20d, 0x257, 0x2a5, 0x2f6, 0x34c, 0x3a4,
    0x3ff, 0x45d, 0x4be, 0x521, 0x586, 0x5ed, 0x655, 0x6bf, 0x729, 0x794
};*/

int sinwave[] = {3226, 3226, 3225, 3223, 3220, 3216, 3211, 3204, 3196, 3188, 3178, 3167, 3154,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 3225, 3226};
uint32_t FS = 2e3;
float TS = 1/float(FS) * 1000000;

int ControlInputPin = 55;			// Sensor pin value
int SensorOutputPin = 9;			// Trigger pin value
int i=0, j=0;                                // loop indexes
char buf[10];			        // string buffer
char buf2[10];			        // string buffer
unsigned long Time;		        // One time marker
unsigned long iniTime;		        // One time marker
int ledPin = 13;
int ControlInput = 0;
int SensorOutput = 0;
int State = 0;

const float K = 1.5;
const uint32_t MIN_DAC_VALUE = 683;
const uint32_t MAX_DAC_VALUE = 3413;
uint32_t aux_input = 0;

void setup() {
  // put your setup code here, to run once:
   //     Serial.begin(9600); 
   //     Serial.println("Initialisation Started");
        analogReadResolution(12);
        analogWriteResolution(12);
     //   Serial.println("Initialisation Done");
        iniTime=millis();       
      // Serial.println("We have a go"); 
       pinMode(ledPin, OUTPUT);
}

void loop() {
  if (i == 1000) {
    i=0;
  }
  
  // Reading control value, averaged 10 times
  ControlInput=0;
  j=0;

  aux_input = analogRead(ControlInputPin);
  if (aux_input < MIN_DAC_VALUE) {
    aux_input = 0;
  }
  else if (aux_input > MAX_DAC_VALUE) {
    aux_input = 4095;
  }
  else {
    aux_input = (aux_input - MIN_DAC_VALUE) * K;
  }
  
  ControlInput = aux_input;
  /* Implementing the problem*/ 
  
  /* State = (sinwave[i] / float(4095)) / 3 + 0.5;
  State = State - ControlInput;*/
  State = sinwave[i] - ControlInput;
  if (State < 0) {
    State = 0;
  }
  else if (State > 4095) {
    State = 4095;
  }
  SensorOutput = int(State);
  
  analogWrite(DAC0, SensorOutput);
  analogWrite(DAC1  , sinwave[i]);
  analogWrite(ledPin,int(State*255));
  
  // Time=millis()-iniTime;
  // Serial.println("Datablock");
  // sprintf(buf,"%e hh\n",SensorOutput                                                                   );  	// " hh" is used to avoid unerased numbers 						// in the buffer. Any other string can be used.
  // Serial.print(buf);
  //sprintf(buf2,"%e hh\n",Time*1.0);  	// " hh" is used to avoid unerased numbers 						// in the buffer. Any other string can be used.
  //delay(1);
  //Serial.print(buf2);
  //delay(1);
  i++;
  delayMicroseconds(TS);
}
